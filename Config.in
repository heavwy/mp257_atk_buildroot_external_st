## Config.in
```kconfig
source "$BR2_EXTERNAL_ST_PATH/package/m4projects/Config.in"
source "$BR2_EXTERNAL_ST_PATH/package/m33projects/Config.in"
source "$BR2_EXTERNAL_ST_PATH/package/eth-switch/Config.in"
source "$BR2_EXTERNAL_ST_PATH/package/fceux/Config.in"
source "$BR2_EXTERNAL_ST_PATH/package/retroarch/Config.in"
source "$BR2_EXTERNAL_ST_PATH/package/libretro-fceumm/Config.in"
source "$BR2_EXTERNAL_ST_PATH/package/retroarch-assets/Config.in"
```

## package/fceux/Config.in
```kconfig
config BR2_PACKAGE_FCEUX
	bool "fceux"
	depends on BR2_INSTALL_LIBSTDCPP
	depends on BR2_PACKAGE_SDL2
	depends on BR2_PACKAGE_ZLIB
	depends on BR2_PACKAGE_LIBPNG
	depends on BR2_PACKAGE_LIBARCHIVE
	depends on BR2_PACKAGE_LUA
	help
	  FCEUX is a cross-platform, multi-purpose NES/Famicom emulator.
	  Designed for STM32MP257 MIPI display via KMS/DRM.

	  http://fceux.com
```

## package/infones/Config.in
```kconfig
config BR2_PACKAGE_INFONES
	bool "infones"
	depends on BR2_PACKAGE_SDL2
	help
	  infones
```

## package/libretro-gpsp/Config.in
```kconfig
config BR2_PACKAGE_LIBRETRO_GPSP
    bool "libretro-gpsp"
    depends on BR2_INSTALL_LIBSTDCPP
    help
      A libretro GBA emulator core for ARM (Optimized with Dynarec).

      http://www.libretro.com

comment "libretro-gpsp needs a toolchain w/ C++"
    depends on !BR2_INSTALL_LIBSTDCPP
```

## package/libretro-mgba/Config.in
```kconfig
config BR2_PACKAGE_LIBRETRO_MGBA
    bool "libretro-mgba"
    depends on BR2_INSTALL_LIBSTDCPP
    depends on BR2_USE_WCHAR              # 必须添加：libzip 的前提条件
    select BR2_PACKAGE_LIBZIP             # 匹配 .mk 里的依赖 
    select BR2_PACKAGE_LIBPNG             # 匹配 .mk 里的依赖 
    select BR2_PACKAGE_ZLIB               # 匹配 .mk 里的依赖 
    select BR2_PACKAGE_RETROARCH          # 必须补充：解决 .mk 里的依赖冲突 
    help
      A libretro GBA emulator core for ARM.

      http://www.libretro.com

comment "libretro-mgba needs a toolchain w/ C++, wchar"
    depends on !BR2_INSTALL_LIBSTDCPP || !BR2_USE_WCHAR
```

## package/retroarch/Config.in
```kconfig
config BR2_PACKAGE_RETROARCH
    bool "retroarch"
    select BR2_PACKAGE_LIBDRM
    select BR2_PACKAGE_GCNANO_BINARIES
    select BR2_PACKAGE_ZLIB
    help
      RetroArch
```
